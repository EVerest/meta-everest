## conf/layer.conf
```bitbake
# We have a conf and classes directory, add to BBPATH
BBPATH .= ":${LAYERDIR}"

# We have recipes-* directories, add to BBFILES
BBFILES += "${LAYERDIR}/recipes-*/*/*.bb \
            ${LAYERDIR}/recipes-*/*/*.bbappend"

BBFILE_COLLECTIONS += "meta-everest"
BBFILE_PATTERN_meta-everest = "^${LAYERDIR}/"

LAYERDEPENDS_meta-everest = "core"
LAYERSERIES_COMPAT_meta-everest = "kirkstone"
```
